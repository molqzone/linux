## Documentation/devicetree/bindings/nvmem/sophgo,cv1800b-efuse.yaml
```yaml
# SPDX-License-Identifier: (GPL-2.0 OR BSD-2-Clause)
%YAML 1.2
---
$id: http://devicetree.org/schemas/nvmem/sophgo,cv1800b-efuse.yaml#
$schema: http://devicetree.org/meta-schemas/core.yaml#

title: Sophgo CV1800B eFuse-based NVMEM

maintainers:
  - Jisheng Zhang <jszhang@kernel.org>

description:
  Sophgo SoCs such as the CV1800B contain factory-programmed eFuses used
  to e.g. store calibration data for the built-in ethernet PHY.

$ref: nvmem.yaml#

properties:
  compatible:
    enum:
      - sophgo,cv1800b-efuse

  reg:
    maxItems: 1

  clocks:
    maxItems: 1

required:
  - compatible
  - reg
  - clocks

unevaluatedProperties: false

examples:
  - |
    #include <dt-bindings/clock/sophgo,cv1800.h>

    efuse@3050000 {
        compatible = "sophgo,cv1800b-efuse";
        reg = <0x3050000 0x1000>;
        clocks = <&clk CLK_EFUSE>;

        nvmem-layout {
            compatible = "fixed-layout";
            #address-cells = <1>;
            #size-cells = <1>;

            ephy_txitune: ephy-txitune@24 {
                reg = <0x24 0x4>;
            };
        };
    };
```
